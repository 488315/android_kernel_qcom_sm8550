## drivers/samsung/Kconfig
```kconfig
source "drivers/samsung/bsp/Kconfig"
source "drivers/samsung/debug/Kconfig"
source "drivers/samsung/power/Kconfig"
source "drivers/samsung/knox/Kconfig"

config SEC_PLATFORM_GTS9WIFI
    	bool "project configuration for gts9wifi"
        default n
```
